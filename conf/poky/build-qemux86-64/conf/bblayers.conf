## conf/poky/build-qemux86-64/conf/bblayers.conf
```bitbake
# POKY_BBLAYERS_CONF_VERSION is increased each time build/conf/bblayers.conf
# changes incompatibly
POKY_BBLAYERS_CONF_VERSION = "2"

BBPATH = "${TOPDIR}"
BBFILES ?= ""

BBLAYERS ?= " \
  /home/fja0568/src/tuxzilla/poky/meta \
  /home/fja0568/src/tuxzilla/poky/meta-poky \
  /home/fja0568/src/tuxzilla/poky/meta-yocto-bsp \
  "
```

## conf/poky/build-rpi/conf/bblayers.conf
```bitbake
# POKY_BBLAYERS_CONF_VERSION is increased each time build/conf/bblayers.conf
# changes incompatibly
POKY_BBLAYERS_CONF_VERSION = "2"

BBPATH = "${TOPDIR}"
BBFILES ?= ""

BBLAYERS ?= " \
  /home/fja0568/src/tuxzilla/poky/meta \
  /home/fja0568/src/tuxzilla/poky/meta-poky \
  /home/fja0568/src/tuxzilla/poky/meta-yocto-bsp \
  /home/fja0568/src/tuxzilla/meta-raspberrypi \
  /home/fja0568/src/tuxzilla/meta-openembedded/meta-oe \
  /home/fja0568/src/tuxzilla/meta-openembedded/meta-multimedia \
  /home/fja0568/src/tuxzilla/meta-openembedded/meta-networking \
  /home/fja0568/src/tuxzilla/meta-openembedded/meta-python \
  "
```
